## kmsgpipe/labs/lab5/Kconfig
```kconfig
menu "Kmsgpipe driver"

config KMSGPIPE_LAB5
	tristate "Kmsgpipe character driver"
	default n
	help
	  Simple character driver for message passing.

config KMSGPIPE_LAB5_KUNIT_TEST
	bool "Kmsgpipe KUnit tests"
	depends on KUNIT && KMSGPIPE_LAB5
	default n
	help
	  Run KUnit tests for kmsgpipe core logic.

endmenu
```
