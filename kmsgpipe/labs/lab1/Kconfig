## kmsgpipe/labs/lab1/Kconfig
```kconfig
menu "Kmsgpipe driver"

config KMSGPIPE_LAB1
	tristate "Kmsgpipe character driver"
	default n
	help
	  Simple character driver for message passing.

config KMSGPIPE_LAB1_KUNIT_TEST
	bool "Kmsgpipe KUnit tests"
	depends on KUNIT && KMSGPIPE_LAB1
	default n
	help
	  Run KUnit tests for kmsgpipe core logic.

endmenu
```

## kmsgpipe/labs/lab1/driver/Kconfig
```kconfig
menu "Kmsgpipe driver"

config KMSGPIPE
	tristate "Kmsgpipe character driver"
	default n
	help
	  Simple character driver for message passing.

config KMSGPIPE_KUNIT_TEST
	bool "Kmsgpipe KUnit tests"
	depends on KUNIT && KMSGPIPE
	default n
	help
	  Run KUnit tests for kmsgpipe core logic.

endmenu
```

## kmsgpipe/labs/lab3/Kconfig
```kconfig
menu "Kmsgpipe driver"

config KMSGPIPE_LAB2
	tristate "Kmsgpipe character driver"
	default n
	help
	  Simple character driver for message passing.

config KMSGPIPE_LAB2_KUNIT_TEST
	bool "Kmsgpipe KUnit tests"
	depends on KUNIT && KMSGPIPE_LAB2
	default n
	help
	  Run KUnit tests for kmsgpipe core logic.

endmenu
```

## kmsgpipe/labs/lab4/Kconfig
```kconfig
menu "Kmsgpipe driver"

config KMSGPIPE_LAB4
	tristate "Kmsgpipe character driver"
	default n
	help
	  Simple character driver for message passing.

config KMSGPIPE_LAB4_KUNIT_TEST
	bool "Kmsgpipe KUnit tests"
	depends on KUNIT && KMSGPIPE_LAB4
	default n
	help
	  Run KUnit tests for kmsgpipe core logic.

endmenu
```
